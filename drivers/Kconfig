## drivers/sensor/battery/Kconfig
```kconfig
# Copyright (c) 2026 Splitkb.com
# SPDX-License-Identifier: MIT

menuconfig SPLITKB_BATTERY_COINCELL
    bool "Coincell battery support"
    default $(dt_compat_enabled,$(DT_COMPAT_SPLITKB_COINCELL_VOLTAGE_DIVIDER))
    select ADC
    select ZMK_BATTERY
    depends on SENSOR
    help
        Enable CR1632 coincell voltage divider driver for battery monitoring

menuconfig SPLITKB_BATTERY_LIPO
    bool "Lipo battery support"
    default $(dt_compat_enabled,$(DT_COMPAT_SPLITKB_LIPO_VOLTAGE_DIVIDER))
    select ADC
    select ZMK_BATTERY
    depends on SENSOR
    help
        Enable Lipo battery voltage divider driver for battery monitoring
```

## dts/bindings/sensor/splitkb,charging-ic-led.yaml
```yaml
# Copyright (c) 2026 splitkb.com
# SPDX-License-Identifier: MIT

description: Charging IC stat pin monitoring and LED control

compatible: "splitkb,charging-ic-led"

properties:
  led-gpios:
    type: phandle-array
    required: true
    description: |
      GPIOs connected to the charging status LEDs.
  
  stat-gpios:
    type: phandle-array
    required: true
    description: |
      GPIO connected to the charging IC status pin.
  
```

## dts/bindings/sensor/splitkb,coincell-voltage-divider.yaml
```yaml
# Copyright (c) 2026 splitkb.com
# SPDX-License-Identifier: MIT

description: Coincell battery SoC monitoring using voltage divider

compatible: "splitkb,coincell-voltage-divider"

include: voltage-divider.yaml
```

## dts/bindings/sensor/splitkb,lipo-voltage-divider.yaml
```yaml
# Copyright (c) 2026 splitkb.com
# SPDX-License-Identifier: MIT

description: Lipo battery SoC monitoring using voltage divider

compatible: "splitkb,lipo-voltage-divider"

include: voltage-divider.yaml
```
